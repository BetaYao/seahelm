## seahelm-watch-fw/sdkconfig.defaults
```kconfig
# seahelm-watch-fw defaults for ESP32-S3-R8N8 (M5Stack StopWatch)

# --- target / flash ---
CONFIG_IDF_TARGET="esp32s3"
CONFIG_ESPTOOLPY_FLASHSIZE_16MB=y
CONFIG_ESPTOOLPY_FLASHMODE_QIO=y
CONFIG_ESPTOOLPY_FLASHFREQ_80M=y
CONFIG_PARTITION_TABLE_CUSTOM=y
CONFIG_PARTITION_TABLE_CUSTOM_FILENAME="partitions.csv"

# --- PSRAM: 8MB octal, needed for LVGL framebuffers ---
CONFIG_SPIRAM=y
CONFIG_SPIRAM_MODE_OCT=y
CONFIG_SPIRAM_SPEED_80M=y
CONFIG_SPIRAM_FETCH_INSTRUCTIONS=y
CONFIG_SPIRAM_RODATA=y
CONFIG_SPIRAM_TRY_ALLOCATE_WIFI_LWIP=y

# --- CPU ---
CONFIG_ESP_DEFAULT_CPU_FREQ_MHZ_240=y
CONFIG_FREERTOS_HZ=1000

# --- main task stack (M5.begin + LVGL init are stack-hungry) ---
CONFIG_ESP_MAIN_TASK_STACK_SIZE=8192

# --- LVGL 9 (via Kconfig from the managed component) ---
CONFIG_LV_COLOR_DEPTH_16=y
CONFIG_LV_USE_OS_NONE=y
CONFIG_LV_MEM_SIZE_KILOBYTES=32
CONFIG_LV_ATTRIBUTE_FAST_MEM_USE_IRAM=y
# HKDF for E2EE key derivation (sh_crypto.c uses mbedtls_hkdf)
CONFIG_MBEDTLS_HKDF_C=y
# Montserrat sizes used by sh_theme.h (default build only ships 14)
CONFIG_LV_FONT_MONTSERRAT_16=y
CONFIG_LV_FONT_MONTSERRAT_18=y
CONFIG_LV_FONT_MONTSERRAT_28=y
CONFIG_LV_FONT_MONTSERRAT_48=y

# mbedtls: dynamic TLS buffers (internal RAM too small; HW crypto needs internal alloc, cannot use PSRAM)
# fixed 8KB TLS in-buffer (dynamic realloc failed reading retained burst)
CONFIG_MBEDTLS_DYNAMIC_BUFFER=n
CONFIG_MBEDTLS_SSL_IN_CONTENT_LEN=8192
```
